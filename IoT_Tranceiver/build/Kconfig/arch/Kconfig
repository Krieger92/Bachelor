## IoT_Tranceiver/build/Kconfig/arch/Kconfig
```kconfig
# Load arch Kconfig descriptions.
osource "/home/krieger/zephyrproject/zephyr/arch/x86/Kconfig"
osource "/home/krieger/zephyrproject/zephyr/arch/xtensa/Kconfig"
osource "/home/krieger/zephyrproject/zephyr/arch/sparc/Kconfig"
osource "/home/krieger/zephyrproject/zephyr/arch/riscv/Kconfig"
osource "/home/krieger/zephyrproject/zephyr/arch/posix/Kconfig"
osource "/home/krieger/zephyrproject/zephyr/arch/nios2/Kconfig"
osource "/home/krieger/zephyrproject/zephyr/arch/mips/Kconfig"
osource "/home/krieger/zephyrproject/zephyr/arch/arm64/Kconfig"
osource "/home/krieger/zephyrproject/zephyr/arch/arm/Kconfig"
osource "/home/krieger/zephyrproject/zephyr/arch/arc/Kconfig"
```
